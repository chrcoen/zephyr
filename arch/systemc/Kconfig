## arch/systemc/Kconfig
```kconfig
# General configuration options

# Copyright (c) 2017 Intel Corporation
# SPDX-License-Identifier: Apache-2.0

menu "POSIX (native) Options"
	depends on ARCH_SYSTEMC

config ARCH
	default "systemc"

endmenu
```

## boards/systemc/cortex_sim/Kconfig
```kconfig
# SPDX-License-Identifier: Apache-2.0

config CONFIG_BOARD_CORTEX_SIM
	bool
	select SYSTEMC_TIMER
	select SYSTEMC_CONSOLE
```

## boards/systemc/cortex_sim/Kconfig.board
```kconfig
# SPDX-License-Identifier: Apache-2.0


config BOARD_CORTEX_SIM
	bool "Cortex-m simulation"
	select 64BIT
	select ESIMP
```

## boards/systemc/cortex_sim/Kconfig.defconfig
```kconfig
# SPDX-License-Identifier: Apache-2.0

if BOARD_CORTEX_SIM

config BOARD
	default "cortex_sim"

config BUILD_OUTPUT_EXE
	default y

config NUM_IRQS
	int
	default 100

config UART_ESIMP
	default y

config GPIO_ESIMP
	default y

if LOG

config LOG_BACKEND_SYSTEMC
	default y

# For native_posix we can log synchronously without any problem
# Doing so will be nicer for debugging
choice LOG_MODE
	default LOG_MODE_IMMEDIATE
endchoice

endif # LOG

if CONSOLE

config SYSTEMC_CONSOLE
	bool
	default y if !SERIAL

endif # CONSOLE


endif # BOARD_CORTEX_SIM
```

## boards/systemc/cortex_sim/cortex_sim_defconfig
```kconfig
# SPDX-License-Identifier: Apache-2.0


CONFIG_SOC_SYSTEMC=y
CONFIG_CONSOLE=y
CONFIG_SYS_CLOCK_HW_CYCLES_PER_SEC=100000000
CONFIG_SYS_CLOCK_TICKS_PER_SEC=10000
CONFIG_CPLUSPLUS=y
CONFIG_LIB_CPLUSPLUS=y
CONFIG_SERIAL=y
```

## drivers/gpio/Kconfig.esimp
```kconfig
# STM32 GPIO configuration

# Copyright (c) 2016 Open-RnD Sp. z o.o.
# SPDX-License-Identifier: Apache-2.0

config GPIO_ESIMP
	bool "GPIO Driver for ESIMP"
	depends on ARCH_SYSTEMC
	help
	  Enable GPIO driver for ESIMP
```

## drivers/serial/Kconfig.esimp
```kconfig
# STM32 UART configuration

# Copyright (c) 2016 Open-RnD Sp. z o.o.
# SPDX-License-Identifier: Apache-2.0


config UART_ESIMP
	bool "ESIMP MCU serial driver"
	select SERIAL_HAS_DRIVER
	select SERIAL_SUPPORT_INTERRUPT
	help
	  This option enables the ESIMP UART driver.
```

## drivers/timer/Kconfig.esimp
```kconfig
config SYSTEMC_TIMER
	bool "systemc timer driver"
	default y
	depends on BOARD_CORTEX_SIM
	select SYSTEM_TIMER_HAS_DISABLE_SUPPORT
	help
	  This module implements a kernel device driver for the systemc HW timer
	  model
```

## dts/bindings/gpio/esimp,gpio.yaml
```yaml
description: ESIMP GPIO

compatible: "esimp,gpio"

include: [gpio-controller.yaml, base.yaml]

properties:
    label:
        required: true
```

## dts/bindings/serial/esimp,uart.yaml
```yaml
description: STM32 USART

compatible: "esimp,uart"

include: uart-controller.yaml

properties:
    reg:
      required: true

    interrupts:
      required: true
```

## modules/Kconfig.esimp
```kconfig
# SPDX-License-Identifier: Apache-2.0
# SPDX-FileCopyrightText: © 2022 Christoph Coenen <chrcoen@gmail.com>

config ESIMP
	bool "Embedded Simulation Platform Support"
	help
	  This option enables spport for the Embedded Simulation Platform.
```

## soc/systemc/systemc/Kconfig.defconfig
```kconfig
# Copyright (c) 2017 Intel Corporation
# SPDX-License-Identifier: Apache-2.0

config SOC
	default "systemc"
	depends on SOC_SYSTEMC
```

## soc/systemc/systemc/Kconfig.soc
```kconfig
# SPDX-License-Identifier: Apache-2.0


config SOC_SYSTEMC
	bool "systemc"
	select ARCH_SYSTEMC
	help
      Welcome to the config bukkake
```
